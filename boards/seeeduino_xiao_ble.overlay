/*
 * Ensure hardware PWM is enabled early enough for Kconfig DT checks.
 *
 * The Titan8000 shield uses pwm0 for the buzzer via a shield overlay.
 * Some Kconfig symbols (e.g. PWM_NRFX) depend on DT_HAS_* checks that
 * require an enabled nordic,nrf-pwm node during Kconfig evaluation.
 */

&pwm0 {
	status = "okay";
};
