/*
 * Copyright (c) 2025 The ZMK Contributors
 *
 * SPDX-License-Identifier: MIT
 */

/ {
    behaviors {
#ifdef CONFIG_TITAN8000_BUZZER
        /omit-if-no-ref/ buzzer_tog: buzzer_tog {
            compatible = "zmk,behavior-buzzer-tog";
            #binding-cells = <0>;
        };
#else
        /omit-if-no-ref/ buzzer_tog: buzzer_tog {
            compatible = "zmk,behavior-none";
            #binding-cells = <0>;
        };
#endif
    };
};
