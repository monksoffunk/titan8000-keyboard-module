/*
 * Copyright (c) 2025 The ZMK Contributors
 * Copyright (c) 2025 monksoffunk
 *
 * SPDX-License-Identifier: MIT
 */

/*
 * Xiao BLE uses the Titan8000 custom kscan driver.
 *
 * Matches the original main-branch electrical polarity:
 * - ACTIVE_HIGH sensing
 * - interrupt line on D10 (active-high with pull-down)
 */
&kscan0 {
		wakeup-source;
        interrupt-gpios = <&xiao_d 10 (GPIO_ACTIVE_LOW | GPIO_PULL_UP)>;
};
